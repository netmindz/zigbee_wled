/*
 * Zigbee DMX Bridge - DMX Output Implementation
 *
 * Dual-mode output:
 *
 * 1. Wired DMX512:
 *    Uses raw UART at 250000 baud, 8N2 through an RS-485 transceiver.
 *    BREAK signal generated by temporarily switching to a lower baud rate.
 *    (We use raw UART rather than the esp_dmx library to avoid IDF version
 *    compatibility issues — the approach is simple and proven.)
 *
 * 2. ArtNet (Art-Net DMX over UDP):
 *    Sends OpDmx (0x5000) packets to the broadcast address on port 6454.
 *    Packet rate matches the main loop DMX update rate (~40Hz).
 *
 * Art-Net packet format (OpDmx):
 *    Bytes 0-7:   "Art-Net\0"
 *    Bytes 8-9:   Opcode 0x5000 (little-endian)
 *    Bytes 10-11: Protocol version 0x000e (big-endian)
 *    Byte 12:     Sequence (0 = disabled, 1-255 = incrementing)
 *    Byte 13:     Physical port (0)
 *    Bytes 14-15: Universe (little-endian, 15-bit: net/subnet/universe)
 *    Bytes 16-17: Data length (big-endian, 2-512, must be even)
 *    Bytes 18+:   DMX channel data (slot 1 to slot N)
 */

#include "dmx_output.h"
#include "driver/uart.h"
#include "driver/gpio.h"
#include <WiFi.h>
#include <WiFiUdp.h>

DmxOutput dmxOutput;

// Use UART1 for wired DMX
static const uart_port_t DMX_UART = UART_NUM_1;

// ArtNet constants
static const uint16_t ARTNET_PORT = 6454;
static const uint8_t ARTNET_HEADER[] = { 'A','r','t','-','N','e','t','\0' };
static const uint16_t ARTNET_OP_DMX = 0x5000;
static const uint16_t ARTNET_PROTOCOL_VER = 14;

// UDP socket for ArtNet output
static WiFiUDP artnetUdp;
static bool artnetUdpStarted = false;

// ---- Build DMX frame from light states ----

void DmxOutput::buildDmxFrame(const LightConfig* lights, const LightState* states, uint8_t count) {
  // Clear data channels (keep start code = 0 at slot 0)
  memset(&dmxData[1], 0, 512);

  for (uint8_t i = 0; i < count; i++) {
    const LightConfig& cfg = lights[i];
    const LightState& state = states[i];

    if (!cfg.active) continue;
    if (cfg.dmxStartAddr < 1 || cfg.dmxStartAddr > 512) continue;

    uint16_t base = cfg.dmxStartAddr;

    // Apply brightness scaling (Zigbee brightness is 0-254)
    float briScale = state.powerOn ? (static_cast<float>(state.brightness) / 254.0f) : 0.0f;

    // Map color channels to DMX addresses
    uint16_t rAddr = base + cfg.channelMap.red;
    uint16_t gAddr = base + cfg.channelMap.green;
    uint16_t bAddr = base + cfg.channelMap.blue;

    if (rAddr >= 1 && rAddr <= 512) dmxData[rAddr] = static_cast<uint8_t>(state.red * briScale);
    if (gAddr >= 1 && gAddr <= 512) dmxData[gAddr] = static_cast<uint8_t>(state.green * briScale);
    if (bAddr >= 1 && bAddr <= 512) dmxData[bAddr] = static_cast<uint8_t>(state.blue * briScale);

    if (cfg.type == LIGHT_TYPE_RGBW) {
      uint16_t wAddr = base + cfg.channelMap.white;
      if (wAddr >= 1 && wAddr <= 512) dmxData[wAddr] = static_cast<uint8_t>(state.white * briScale);
    }
  }
}

// ---- Wired DMX via raw UART ----

void DmxOutput::beginWiredDmx() {
  const OutputConfig& oc = configStore.getOutputConfig();
  int txPin = oc.txPin;
  int enPin = oc.enPin;

  // Configure RS-485 enable pin if set
  if (enPin >= 0) {
    gpio_set_direction(static_cast<gpio_num_t>(enPin), GPIO_MODE_OUTPUT);
    gpio_set_level(static_cast<gpio_num_t>(enPin), 1);  // Enable TX
  }

  // Configure UART for DMX: 250000 baud, 8N2
  uart_config_t uart_config = {};
  uart_config.baud_rate = 250000;
  uart_config.data_bits = UART_DATA_8_BITS;
  uart_config.parity    = UART_PARITY_DISABLE;
  uart_config.stop_bits = UART_STOP_BITS_2;
  uart_config.flow_ctrl = UART_HW_FLOWCTRL_DISABLE;
  uart_config.source_clk = UART_SCLK_DEFAULT;

  esp_err_t err = uart_param_config(DMX_UART, &uart_config);
  if (err != ESP_OK) {
    ESP_LOGE("DMX", "uart_param_config failed: 0x%x", err);
    return;
  }

  // Use -1 for RX since we don't receive DMX
  err = uart_set_pin(DMX_UART, txPin, -1, UART_PIN_NO_CHANGE, UART_PIN_NO_CHANGE);
  if (err != ESP_OK) {
    ESP_LOGE("DMX", "uart_set_pin failed: 0x%x", err);
    return;
  }

  // Install UART driver (TX buffer of 1024 bytes, RX buffer >= SOC_UART_FIFO_LEN)
  err = uart_driver_install(DMX_UART, 256, 1024, 0, NULL, 0);
  if (err != ESP_OK) {
    ESP_LOGE("DMX", "uart_driver_install failed: 0x%x", err);
    return;
  }

  dmxPort = DMX_UART;
  ESP_LOGI("DMX", "Wired DMX output initialized on TX=%d, EN=%d", txPin, enPin);
}

void DmxOutput::sendWiredDmx() {
  if (dmxPort < 0) return;

  // Generate BREAK by sending a zero byte at ~90909 baud
  // At 90909 baud, one byte frame = ~110us (satisfies >=88us BREAK requirement)
  uart_wait_tx_done(DMX_UART, pdMS_TO_TICKS(100));
  uart_set_baudrate(DMX_UART, 90909);
  uint8_t breakByte = 0x00;
  uart_write_bytes(DMX_UART, &breakByte, 1);
  uart_wait_tx_done(DMX_UART, pdMS_TO_TICKS(100));
  // Restore DMX baud rate (MAB is the idle line between BREAK and data)
  uart_set_baudrate(DMX_UART, 250000);

  // Send start code + channel data
  uart_write_bytes(DMX_UART, dmxData, sizeof(dmxData));
}

void DmxOutput::stopWiredDmx() {
  if (dmxPort < 0) return;

  const OutputConfig& oc = configStore.getOutputConfig();
  uart_driver_delete(DMX_UART);
  if (oc.enPin >= 0) {
    gpio_set_level(static_cast<gpio_num_t>(oc.enPin), 0);
  }
  dmxPort = -1;
}

// ---- ArtNet via UDP ----

void DmxOutput::beginArtNet() {
  if (!WiFi.isConnected()) {
    ESP_LOGW("DMX", "ArtNet: WiFi not connected, will start when connected");
    // We'll try again on each send
    return;
  }

  if (!artnetUdpStarted) {
    artnetUdp.begin(ARTNET_PORT);
    artnetUdpStarted = true;
  }
  artnetSequence = 1;
  artnetSendErrors = 0;

  const OutputConfig& oc = configStore.getOutputConfig();
  ESP_LOGI("DMX", "ArtNet output initialized (universe=%d)", oc.artnetUniverse);
}

void DmxOutput::sendArtNet() {
  if (!WiFi.isConnected()) return;

  // Lazy init if WiFi wasn't ready at begin()
  if (!artnetUdpStarted) {
    artnetUdp.begin(ARTNET_PORT);
    artnetUdpStarted = true;
    artnetSendErrors = 0;
    ESP_LOGI("DMX", "ArtNet UDP socket started (late init)");
  }

  const OutputConfig& oc = configStore.getOutputConfig();

  // Build Art-Net OpDmx packet
  // DMX data starts at dmxData[1] (slot 0 is start code, not sent in ArtNet)
  uint16_t dmxLength = 512;
  // ArtNet requires even length
  if (dmxLength % 2 != 0) dmxLength++;

  uint8_t packet[18 + 512];
  // Header
  memcpy(packet, ARTNET_HEADER, 8);
  // Opcode (LE)
  packet[8]  = ARTNET_OP_DMX & 0xFF;
  packet[9]  = (ARTNET_OP_DMX >> 8) & 0xFF;
  // Protocol version (BE)
  packet[10] = (ARTNET_PROTOCOL_VER >> 8) & 0xFF;
  packet[11] = ARTNET_PROTOCOL_VER & 0xFF;
  // Sequence
  packet[12] = artnetSequence;
  // Physical port
  packet[13] = 0;
  // Universe (LE)
  packet[14] = oc.artnetUniverse & 0xFF;
  packet[15] = (oc.artnetUniverse >> 8) & 0xFF;
  // Data length (BE)
  packet[16] = (dmxLength >> 8) & 0xFF;
  packet[17] = dmxLength & 0xFF;
  // DMX data (channels 1-512 from dmxData[1])
  memcpy(&packet[18], &dmxData[1], 512);

  // Determine target: unicast to configured IP, or subnet broadcast
  IPAddress targetIp;
  if (oc.artnetTargetIp[0] != '\0' && targetIp.fromString(oc.artnetTargetIp)) {
    // Unicast to configured target
  } else {
    // Subnet broadcast
    IPAddress localIp = WiFi.localIP();
    IPAddress subnetMask = WiFi.subnetMask();
    targetIp = IPAddress(
      localIp[0] | ~subnetMask[0],
      localIp[1] | ~subnetMask[1],
      localIp[2] | ~subnetMask[2],
      localIp[3] | ~subnetMask[3]
    );
  }

  artnetUdp.beginPacket(targetIp, ARTNET_PORT);
  artnetUdp.write(packet, 18 + dmxLength);
  int ok = artnetUdp.endPacket();

  if (ok) {
    if (artnetSendErrors > 0) {
      ESP_LOGI("DMX", "ArtNet send recovered after %lu errors", artnetSendErrors);
    }
    artnetSendErrors = 0;

    // Increment sequence (1-255, skip 0 which means disabled)
    artnetSequence++;
    if (artnetSequence == 0) artnetSequence = 1;
  } else {
    artnetSendErrors++;
    // Rate-limit logging: only log at powers of 2
    if ((artnetSendErrors & (artnetSendErrors - 1)) == 0) {
      ESP_LOGW("DMX", "ArtNet send failed (%lu consecutive)", artnetSendErrors);
    }
  }
}

void DmxOutput::stopArtNet() {
  if (artnetUdpStarted) {
    artnetUdp.stop();
    artnetUdpStarted = false;
  }
  artnetSequence = 0;
  artnetSendErrors = 0;
}

// ---- Public API ----

void DmxOutput::begin() {
  if (initialized) return;

  memset(dmxData, 0, sizeof(dmxData));
  currentMode = configStore.getOutputConfig().mode;

  switch (currentMode) {
    case OUTPUT_MODE_WIRED_DMX:
      beginWiredDmx();
      break;
    case OUTPUT_MODE_ARTNET:
      beginArtNet();
      break;
  }

  initialized = true;
  ESP_LOGI("DMX", "Output started in %s mode",
           currentMode == OUTPUT_MODE_ARTNET ? "ArtNet" : "Wired DMX");
}

void DmxOutput::reconfigure() {
  stop();
  begin();
}

void DmxOutput::update(const LightConfig* lights, const LightState* states, uint8_t count) {
  if (!initialized) return;

  buildDmxFrame(lights, states, count);

  switch (currentMode) {
    case OUTPUT_MODE_WIRED_DMX:
      sendWiredDmx();
      break;
    case OUTPUT_MODE_ARTNET:
      sendArtNet();
      break;
  }
}

void DmxOutput::stop() {
  if (!initialized) return;

  switch (currentMode) {
    case OUTPUT_MODE_WIRED_DMX:
      stopWiredDmx();
      break;
    case OUTPUT_MODE_ARTNET:
      stopArtNet();
      break;
  }

  initialized = false;
  ESP_LOGI("DMX", "Output stopped");
}
